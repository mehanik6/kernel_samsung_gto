/* Copyright (c) 2015-2018, The Linux Foundation. All rights reserved.
 *
 * This program is free software; you can redistribute it and/or modify
 * it under the terms of the GNU General Public License version 2 and
 * only version 2 as published by the Free Software Foundation.
 *
 * This program is distributed in the hope that it will be useful,
 * but WITHOUT ANY WARRANTY; without even the implied warranty of
 * MERCHANTABILITY or FITNESS FOR A PARTICULAR PURPOSE.  See the
 * GNU General Public License for more details.
 */

#include "dsi-panel-sim-video.dtsi"
#include "dsi-panel-jd9366-txd-wxga-video.dtsi"
#include "dsi-panel-ili9881c-wxga-video-ld.dtsi"
#include "dsi-panel-jd9367-wxga-video-txd.dtsi"
#include "dsi-panel-ft8201-truly-wxga-video.dtsi"
