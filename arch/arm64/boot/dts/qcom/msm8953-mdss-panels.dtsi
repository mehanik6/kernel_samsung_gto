/* Copyright (c) 2015-2018, The Linux Foundation. All rights reserved.
 *
 * This program is free software; you can redistribute it and/or modify
 * it under the terms of the GNU General Public License version 2 and
 * only version 2 as published by the Free Software Foundation.
 *
 * This program is distributed in the hope that it will be useful,
 * but WITHOUT ANY WARRANTY; without even the implied warranty of
 * MERCHANTABILITY or FITNESS FOR A PARTICULAR PURPOSE.  See the
 * GNU General Public License for more details.
 */

#include "dsi-panel-sim-video.dtsi"
#include "dsi-panel-ili9881h-truly-hdp-video.dtsi"
#include "dsi-panel-ft8006p-tianma-hdp-video.dtsi"
#include "dsi-panel-ili9881h-hlt-hdp-video.dtsi"
#include "dsi-panel-ili9881h-inl-hdp-video.dtsi"
#include "dsi-panel-ili9881h-inx-hdp-video.dtsi"
#include "dsi-panel-nt36525b-txd-hdp-video.dtsi"
#include "dsi-adv7533-1080p.dtsi"

&dsi_adv7533_1080p {
	qcom,mdss-dsi-panel-timings-phy-v2 = [24 1f 08 09 05 03 04 a0
		24 1f 08 09 05 03 04 a0
		24 1f 08 09 05 03 04 a0
		24 1f 08 09 05 03 04 a0
		24 1b 08 09 05 03 04 a0];
};
